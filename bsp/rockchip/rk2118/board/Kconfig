## bsp/rockchip/rk2118/board/Kconfig
```kconfig
menu "RT-Thread board config"

    config IS_FPGA
        bool "Is FPGA Board"
        default n
choice
    prompt "Clock config"
    default RT_USING_CLK_CONFIG0

    config RT_USING_CLK_CONFIG0
        bool "clk config0: for RK2118M"

    config RT_USING_CLK_CONFIG1
        bool "clk config1: for rk2118BM"

    config RT_USING_CLK_CONFIG2
        bool "clk config2: for rk2118G or RK2118B"

endchoice

choice
    prompt "Board Type"
    default RT_USING_BOARD_FPGA

    config RT_USING_BOARD_FPGA
        bool "Enable FPGA board"
        select IS_FPGA

    config RT_USING_BOARD_ADSP_DEMO
        bool "Enable ADSP demo board"

    config RT_USING_BOARD_IOTEST
        bool "Enable io test board"

    config RT_USING_BOARD_SOUNDBAR_CORE
        bool "Enable soundbar core board"

    config RT_USING_BOARD_EVB
        bool "Enable evb board"

    config RT_USING_BOARD_TEST1
        bool "Enable test1 board"

endchoice

config RT_USING_HIFI4
    bool "Enable hifi4 driver"
    default n

endmenu
```

## bsp/rockchip/rk3562-mcu/Kconfig
```kconfig
mainmenu "RT-Thread Configuration"

config BSP_DIR
    string
    option env="BSP_ROOT"
    default "."

config RTT_DIR
    string
    option env="RTT_ROOT"
    default "../../.."

config PKGS_DIR
    string
    option env="PKGS_ROOT"
    default "packages"

choice
    prompt "RK3562 MCU"
    default RKMCU_RK3562_BUS

    config RKMCU_RK3562_PMU
        select ARCH_ARM_CORTEX_M0
        bool "RK3562 MCU of PMU(no cache)"

    config RKMCU_RK3562_BUS
        select ARCH_ARM_CORTEX_M0
        bool "RK3562 MCU of BUS"
endchoice

source "$RTT_DIR/Kconfig"
source "$BSP_DIR/drivers/Kconfig"
source "$BSP_DIR/board/Kconfig"
#source "$PKGS_DIR/Kconfig"
source "$BSP_DIR/../common/tests/Kconfig"
```
